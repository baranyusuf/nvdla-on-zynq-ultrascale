/*
 * CAUTION: This file is automatically generated by Xilinx.
 * Version: XSCT 
 * Today is: Fri Aug 29 13:00:17 2025
 */


/ {
	amba_pl: pl-bus {
		#address-cells = <2>;
		#size-cells = <2>;
		compatible = "simple-bus";
		ranges ;
		NV_nvdla_wrapper_0: NV_nvdla_wrapper@a0000000 {
			clock-names = "core_clk", "csb_clk";
			clocks = <&zynqmp_clk 71>, <&zynqmp_clk 71>;
			compatible = "xlnx,NV-nvdla-wrapper-1.0";
			interrupt-names = "dla_intr";
			interrupt-parent = <&gic>;
			interrupts = <0 89 4>;
			reg = <0x0 0xa0000000 0x0 0x10000>;
		};
	};
};
