/*
 * CAUTION: This file is automatically generated by Xilinx.
 * Version: XSCT 
 * Today is: Fri Aug 29 13:00:17 2025
 */


/dts-v1/;
#include "zynqmp.dtsi"
#include "zynqmp-u-boot.dtsi"
#include "zynqmp-clk-ccf.dtsi"
#include "zcu102-rev1.0.dtsi"
#include "pl.dtsi"
#include "pcw.dtsi"
/ {
	chosen {
		bootargs = "earlycon";
		stdout-path = "serial0:n8";
	};
	aliases {
		i2c0 = &i2c0;
		serial0 = &dcc;
	};
	memory@0 {
		device_type = "memory";
		reg = <0x0 0x0 0x0 0x7ff00000>;
	};
};
#include "system-user.dtsi"
