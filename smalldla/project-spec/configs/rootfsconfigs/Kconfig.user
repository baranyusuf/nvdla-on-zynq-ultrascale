## smalldla/project-spec/configs/rootfsconfigs/Kconfig.user
```kconfig
menu "user packages " 
config gpio-demo  
	 bool "gpio-demo"
	 help
	
config opendla  
	 bool "opendla"
	 help
	
config peekpoke  
	 bool "peekpoke"
	 help
	
config testmod  
	 bool "testmod"
	 help
	
endmenu
```
